## firmware/sdkconfig.defaults
```kconfig
# ESP32-S3-WROOM-1-N16R8: 16MB flash, 8MB octal PSRAM.
CONFIG_IDF_TARGET="esp32s3"

# Flash 16MB, QIO
CONFIG_ESPTOOLPY_FLASHMODE_QIO=y
CONFIG_ESPTOOLPY_FLASHSIZE_16MB=y

# Custom partition table
CONFIG_PARTITION_TABLE_CUSTOM=y
CONFIG_PARTITION_TABLE_CUSTOM_FILENAME="partitions.csv"

# Octal PSRAM at 80MHz
CONFIG_SPIRAM=y
CONFIG_SPIRAM_MODE_OCT=y
CONFIG_SPIRAM_SPEED_80M=y

# FreeRTOS 1kHz tick, larger main task stack for LVGL/cJSON init
CONFIG_FREERTOS_HZ=1000
CONFIG_ESP_MAIN_TASK_STACK_SIZE=8192

# Optimize for size
CONFIG_COMPILER_OPTIMIZATION_SIZE=y
```
